## firmware/main/Kconfig
```kconfig
menu "cambot general"

# general options

    config CAMBOT_WIFI_SSID
        string "ssid"
        help
            the wifi network to be used by the smartscreen

    config CAMBOT_WIFI_PASSWORD
        string "wifi password"
        help
            the wifi password to be used by the smartscreen

    config CAMBOT_DISPLAY_CLOCK_PIN
        int "display clock pin"
        default 15
        help
            I2C clock pin for the display controller

    config CAMBOT_DISPLAY_DATA_PIN
        int "display data pin"
        default 4
        help
            I2C data pin for the display controller

    config CAMBOT_DISPLAY_RESET_PIN
        int "display reset pin"
        default 16
        help
            reset pin for the display controller

    config CAMBOT_HOSTNAME
        string "host name"
        default "cambot"
        help
            the mDNS name of this device

    config CAMBOT_STEPPER_CYCLE_TIME
        int "stepper cycle time (microseconds)"
        default 1000
        help
            This value determines the length of one stepper control cycle.

endmenu

menu "cambot pins"

    config CAMBOT_YAW_DIRECTION_PIN
        int "yaw direction pin"
        default 21
        help
            direction pin of tb6560 controlling the yaw rotation at the base of the robot

    config CAMBOT_YAW_CLOCK_PIN
        int "yaw clock pin"
        default 22
        help
            clock pin of tb6560 controlling the yaw rotation at the base of the robot

    config CAMBOT_LOWER_VERT_1_DIRECTION_PIN
        int "lower vert 1 direction pin"
        default 19
        help
            direction pin of tb6560 controlling the first motor of the vertical joint closest to the base

    config CAMBOT_LOWER_VERT_1_CLOCK_PIN
        int "lower vert 1 clock pin"
        default 23
        help
            clock pin of tb6560 controlling the first motor of the vertical joint closest to the base

    config CAMBOT_LOWER_VERT_2_DIRECTION_PIN
        int "lower vert 2 direction pin"
        default 18
        help
            direction pin of tb6560 controlling the second motor of the vertical joint closest to the base

    config CAMBOT_LOWER_VERT_2_CLOCK_PIN
        int "lower vert 2 clock pin"
        default 5
        help
            clock pin of tb6560 controlling the second motor of the vertical joint closest to the base

    config CAMBOT_UPPER_VERT_DIRECTION_PIN
        int "upper vert direction pin"
        default 3
        help
            direction pin of tb6560 controlling the motor of the upper vertical joint

    config CAMBOT_UPPER_VERT_CLOCK_PIN
        int "upper vert clock pin"
        default 2
        help
            clock pin of tb6560 controlling the motor of the upper vertical joint

    config CAMBOT_ROLL_DIRECTION_PIN
        int "roll direction pin"
        default 25
        help
            direction pin of tb6560 controlling the motor of the roll joint

    config CAMBOT_ROLL_CLOCK_PIN
        int "roll clock pin"
        default 26
        help
            clock pin of tb6560 controlling the motor of the roll joint

    config CAMBOT_PITCH_DIRECTION_PIN
        int "pitch direction pin"
        default 27
        help
            direction pin of tb6560 controlling the motor of the pitch joint

    config CAMBOT_PITCH_CLOCK_PIN
        int "pitch clock pin"
        default 14
        help
            clock pin of tb6560 controlling the motor of the pitch joint

endmenu

menu "cambot dimensions"

    config CAMBOT_YAW_NUM_STEPS
        int "num yaw steps"
        default 32276
        help
            the number of steps it takes for a full rotation of the yaw actuator

    config CAMBOT_LOWER_VERT_NUM_STEPS
        int "num lower vert steps"
        default 17228
        help
            the number of steps it takes for a full rotation of the lower vert actuator

    config CAMBOT_UPPER_VERT_NUM_STEPS
        int "num upper vert steps"
        default 72344
        help
            the number of steps it takes for a full rotation of the upper vert actuator

    config CAMBOT_ROLL_NUM_STEPS
        int "num roll steps"
        default 3204
        help
            the number of steps it takes for a full rotation of the roll actuator

    config CAMBOT_PITCH_NUM_STEPS
        int "num pitch steps"
        default 14588
        help
            the number of steps it takes for a full rotation of the pitch actuator

    config CAMBOT_LENGTH_BASE_TO_LOWER_VERT
        int "length base to lower vert (mm)"
        default 235
        help
            the distance of the base plate to the axis of the lower vert joint in millimeters

    config CAMBOT_LENGTH_LOWER_VERT_TO_UPPER_VERT
        int "length lower vert to upper vert (mm)"
        default 222
        help
            the distance of the axis of the lower vert joint to the axis of the upper vert joint in millimeters

    config CAMBOT_LENGTH_UPPER_VERT_TO_PITCH
        int "length lower vert to upper vert (mm)"
        default 222
        help
            the distance of the axis of the upper vert joint to the axis of the pitch joint in millimeters

    config CAMBOT_LENGTH_PITCH_TO_TOOL
        int "length pitch to tool (mm)"
        default 185
        help
            the distance of the axis of the pitch joint to the center of the tool
endmenu
```
